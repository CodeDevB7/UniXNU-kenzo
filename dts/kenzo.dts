/dts-v1/;
#include "msm8956.dtsi"

/ {
    model = "Xiaomi Redmi Note 3 (kenzo)";
    compatible = "xiaomi,kenzo", "qcom,msm8956";

    memory@80000000 {
        device_type = "memory";
        // Base: 0x80000000, 2GB or 3GB
        reg = <0x0 0x80000000 0x0 0x80000000>;
    };

    chosen {
        bootargs = "-v serial=3";
        stdout-path = "/soc/serial@78b0000";
    };
};
